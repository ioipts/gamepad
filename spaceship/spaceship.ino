/**
 * LOLIN(WEMOS) D1 R2 & Mini
 * Green SPI_MODE2
 * Blue SPI_MODE3
 */

//#define _PCF8574AP
//#define _MODE3
const char* id="MEKMOK_GAME"; 
const char* ver="20220101";

#include "user_interface.h"
#include <ESP8266WiFi.h>  
#include <ESP8266WebServer.h>
#include <ESP8266HTTPClient.h>
#include <SoftwareSerial.h>
#include <WiFiClient.h>
#include <Wire.h>
#include "PCF8574.h"
#include <Adafruit_GFX.h>    // Core graphics library
#include <Adafruit_ST7789.h> // Hardware-specific library for ST7789

WiFiClient wifiClient;
ESP8266WebServer server(80); 
bool pcf8574;

#if defined(_PCF8574AP)
PCF8574 pcf(0x38);
#define PCFADDR 0x38
#else
PCF8574 pcf(0x20);
#define PCFADDR 0x20
#endif

Adafruit_ST7789 tft=Adafruit_ST7789(10,D8,D6);  //DC,RS
unsigned long myTime;

void handleRoot() {
  char msg[2048];  
  struct station_config conf;
  wifi_station_get_config(&conf);
  sprintf(msg,"<!DOCTYPE html><html><head><meta charset=\"UTF-8\"><style> a:link, a:visited {color: white;padding: 5px 5px;text-align: center;text-decoration: none;display: inline-block;} a:hover, a:active { background-color: #0070a1; }</style></head><body style=\"background-color:#6491c2\">Hello2</body></html>");
  server.send(200, "text/html", msg);   
}

void setup() {
  pinMode(D0, OUTPUT);
  digitalWrite(D0, HIGH);         //enable display
  for (int i=0;i<=5;i++)
  {
   pcf.pinMode(i,INPUT);      
   pcf.pinMode(i, INPUT_PULLUP);
  }
  pcf.begin();
  
  Wire.begin( D2,D1);             //SDA, SCL
  Wire.setClock( 100000 );        //26/1/2020 tested with oled work for some sensor if remove
  Wire.beginTransmission(PCFADDR);
  delay(10);
  pcf8574=(!Wire.endTransmission());

  struct station_config conf;
  wifi_station_get_config(&conf);
  wifi_status_led_uninstall();
  WiFi.mode(WIFI_AP_STA);      
  WiFi.hostname(id);        
  WiFi.softAP(id, "");    
  server.on("/", handleRoot);    
  server.begin();     

  tft.init(240,240);
#if defined(_MODE3)
  tft.init(240, 240, SPI_MODE3); 
#else
  tft.init(240, 240, SPI_MODE2); 
#endif
  tft.fillScreen(ST77XX_WHITE);  
  tft.setRotation(2); 
  myTime=millis();
}

int16_t rainbowcolor(int angle) {
  byte red, green, blue;
  if (angle<60) {red = 255; green = round(angle*4.25-0.01); blue = 0;} else
  if (angle<120) {red = round((120-angle)*4.25-0.01); green = 255; blue = 0;} else 
  if (angle<180) {red = 0, green = 255; blue = round((angle-120)*4.25-0.01);} else 
  if (angle<240) {red = 0, green = round((240-angle)*4.25-0.01); blue = 255;} else 
  if (angle<300) {red = round((angle-240)*4.25-0.01), green = 0; blue = 255;} else 
                 {red = 255, green = 0; blue = round((360-angle)*4.25-0.01);} 
 //5,6,5
  return (int)((red*0x1F)/255)*0x7FF +
         (int)((green*0x3F)/255)*0x1F + 
         (int)((blue*0x1F)/255);
}
 
void drawRainbow() {
    for (int i=0;i<240;i++) {
      tft.drawFastHLine(0, i, 240, rainbowcolor(360*i/240));
    } 
}

//spaceship
int px=0;
int py=0;
int x=120;
int y=200;
int s=16; //radius

//bullet
int bx=-1;
int by=-10;
int pby=-10;

//astroid
int ax=120;
int ay=-10;
int pay=-1;

const uint16_t spaceship[]={
0xffff, 0xffff, 0xffff, 0xffff, 0xffff, 0xffff, 0xffff, 0xffff, 0xffff, 0xffff, 0xffff, 0xffff, 0xffff, 0xffff, 0xffff, 0xffff, 0xffff, 0xffff, 0xffff, 0xffff, 0xffff, 0xffff, 0xffff, 0xffff, 0xffff, 0xffff, 0xffff, 0xffff, 0xffff, 0xffff, 0xffff, 0xffff, 
0xffff, 0xffff, 0xffff, 0xffff, 0xffff, 0xffff, 0xffff, 0xffff, 0xffff, 0xffff, 0xffff, 0xffff, 0xffff, 0xffff, 0xe5d7, 0xc2ec, 0xc2cc, 0xdd35, 0xffff, 0xffff, 0xffff, 0xffff, 0xffff, 0xffff, 0xffff, 0xffff, 0xffff, 0xffff, 0xffff, 0xffff, 0xffff, 0xffff, 
0xffff, 0xffff, 0xffff, 0xffff, 0xffff, 0xffff, 0xffff, 0xffff, 0xffff, 0xffff, 0xffff, 0xffff, 0xffff, 0xd3d0, 0xb000, 0xc800, 0xc800, 0xb000, 0xc2cc, 0xffff, 0xffff, 0xffff, 0xffff, 0xffff, 0xffff, 0xffff, 0xffff, 0xffff, 0xffff, 0xffff, 0xffff, 0xffff, 
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0xffff, 0xffff, 0xffff, 0xffff, 0xffff, 0xffff, 0xffff, 0xffff, 0xffff, 0xffff, 0xffff, 0xffff, 0xffff, 0xffff, 0xffff, 0xffff, 0xffff, 0xffff, 0xffff, 0xffff, 0xffff, 0xffff, 0xffff, 0xffff, 0xffff, 0xffff, 0xffff, 0xffff, 0xffff, 0xffff, 0xffff, 0xffff
  };

const uint16_t astroid[]= {
0xffff, 0xffff, 0xffff, 0xffff, 0xffff, 0xffff, 0xffff, 0xffff, 0xffff, 0xffff, 0xffff, 0xffff, 0xffff, 0xffff, 0xffff, 0xffff, 0xffff, 0xffff, 0xffff, 0xffff, 0xffff, 0xffff, 0xffff, 0xffff, 0xffff, 0xffff, 0xffff, 0xffff, 0xffff, 0xffff, 0xffff, 0xffff, 
0xffff, 0xffff, 0xffff, 0xffff, 0xffff, 0xffff, 0xffff, 0xffff, 0xffff, 0xffff, 0xffff, 0xffff, 0xffff, 0xffff, 0xffff, 0xffff, 0xffff, 0xffff, 0xffff, 0xffff, 0xffff, 0xffff, 0xffff, 0xffff, 0xffff, 0xffff, 0xffff, 0xffff, 0xffff, 0xffff, 0xffff, 0xffff, 
0xffff, 0xffff, 0xffff, 0xffff, 0xffff, 0xffff, 0xffff, 0xffff, 0xffff, 0xffff, 0xffdf, 0xffff, 0xffff, 0xffff, 0xffff, 0xffff, 0xef7d, 0xe71c, 0xdedb, 0xdedb, 0xe73c, 0xf7be, 0xffff, 0xffff, 0xffff, 0xffff, 0xffff, 0xffff, 0xffff, 0xffff, 0xffff, 0xffff, 
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0xffff, 0xffff, 0xffff, 0xffff, 0xffff, 0xffff, 0xffff, 0xffff, 0xffff, 0xffff, 0xffff, 0xffff, 0xffff, 0xffff, 0xffff, 0xffff, 0xffff, 0xffff, 0xffff, 0xffff, 0xffff, 0xffff, 0xffff, 0xffff, 0xffff, 0xffff, 0xffff, 0xffff, 0xffff, 0xffff, 0xffff, 0xffff
};

void loop () {
  unsigned long now = millis();
  unsigned long d=now-myTime;
  if (pcf8574) {
    if (pcf.digitalRead(0)==LOW) {
      y=y-2;
      if (y<s) y=s;
    } 
    if (pcf.digitalRead(3)==LOW) {
      y=y+2;
      if (y>240-s) y=240-s;
    }  
    
    if (pcf.digitalRead(1)==LOW) {
      x=x-2;
      if (x<s) x=s;
    } 
    if (pcf.digitalRead(2)==LOW) {
      x=x+2;
      if (x>240-s) x=240-s;
    } 
    
    if (pcf.digitalRead(4)==LOW) {
      drawRainbow();
      px=-1;
      py=-1;
    } 
    if (pcf.digitalRead(5)==LOW) {
      if (by<=-10)
      {
        by=y-s-6+d;
        bx=x;
        pby=-1;       
      }
    }
    //astriod
    if (ay==-10) {
      ax=random(17, 240-17);
      pay=-1;
    }
    if (ay>270) {
      ay=-10;
    } else 
      ay=ay+1;
    if (pay!=ay) {
      tft.drawRGBBitmap(ax-16,ay-16, astroid, 32,32);
      pay=ay;      
    }
    //spaceship
    if ((px!=x) || (py!=y)) 
    {      
      tft.drawRGBBitmap(x-s,y-s, spaceship, 32,32);
      tft.drawRect(x-s-1,y-s-1,s*2+2,s*2+2,ST77XX_WHITE);
      px=x;
      py=y;
    }
    //bullet
    if (by>-10) 
    {
      by=by-d;
      //detect
      if ((by+d>=ay-16) && (by<=ay+16) && (bx>=ax-16) && (bx<=ax+16))
      {
       tft.fillRect(bx-3,by-5,6,10,ST77XX_WHITE);
       tft.fillRect(ax-16,ay-16,32,32,ST77XX_WHITE);
       //by=-10;
       //pby=-10;
       ay=-10;       
       ax=-10;
      } 
      if (pby!=by) {
        tft.fillRect(bx-3,by-5, 6, 10, ST77XX_BLACK);
        tft.fillRect(bx-3,by+5,6,pby-by+1,ST77XX_WHITE);
        pby=by;
      }    
    }
  }
  myTime=now;
  //server.handleClient();  
}
